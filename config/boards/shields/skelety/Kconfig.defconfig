## config/boards/shields/skelety/Kconfig.defconfig
```kconfig
if SHIELD_SKELETYL_RENE_LEFT

config ZMK_KEYBOARD_NAME
	default "skeletyl_rene"

config ZMK_SPLIT_ROLE_CENTRAL
	default y

endif

if SHIELD_SKELETYL_RENE_LEFT || SHIELD_SKELETYL_RENE_RIGHT

config ZMK_SPLIT
	default y

endif
```

## config/boards/shields/skelety/Kconfig.shield
```kconfig
config SHIELD_SKELETYL_RENE_LEFT
    def_bool $(shields_list_contains,skeletyl_rene_left)

config SHIELD_SKELETYL_RENE_RIGHT
    def_bool $(shields_list_contains,skeletyl_rene_right)
```
